## prj.conf
```kconfig
# # # Mbed TLS
CONFIG_MBEDTLS=y
CONFIG_MBEDTLS_BUILTIN=y
CONFIG_MBEDTLS_PSA_CRYPTO_C=y

CONFIG_LOG=y
CONFIG_LOG_DEFAULT_LEVEL=3
CONFIG_SECURE_STORAGE=y

CONFIG_PSA_WANT_KEY_TYPE_AES=y
CONFIG_PSA_WANT_ALG_CTR=y

CONFIG_ENTROPY_GENERATOR=y

CONFIG_TEST_RANDOM_GENERATOR=y
CONFIG_TIMER_RANDOM_GENERATOR=y
CONFIG_SECURE_STORAGE_ITS_IMPLEMENTATION_ZEPHYR=y
CONFIG_MBEDTLS_PSA_CRYPTO_EXTERNAL_RNG_ALLOW_NON_CSPRNG=y

CONFIG_SECURE_STORAGE_ITS_STORE_IMPLEMENTATION_SETTINGS=y
CONFIG_SETTINGS_NVS=y
CONFIG_NVS=y
```

## src/main.c
```c
#include <psa/crypto.h>
#include <zephyr/kernel.h>

#define PERSISTENT_KEY_ID (PSA_KEY_ID_USER_MIN + 1)

#define NUM_REPETITIONS 1000

int main(void){

	psa_key_id_t key_handle;

	psa_crypto_init();
	printk("Starting key loading performance test...\n");

	for (int i = 0; i < NUM_REPETITIONS; i++){
		psa_status_t status = psa_open_key(PERSISTENT_KEY_ID, &key_handle);
		if(status != PSA_SUCCESS){
			printk("Failed to open the key: %d\n!", (int)status);
			break;
		}

		psa_close_key(key_handle);
	}

	printk("Test completed.\n");
	exit(0);
	return 0;
}
```
