## profiling/psa_encrypt_test/testcase.yaml
```yaml
tests:
  # section.subsection
  sample.testing.ztest:
    # build_only: true
    platform_allow:
      - native_posix
      - native_sim
      - qemu_cortex_m3
    integration_platforms:
      - native_sim
      - qemu_cortex_m3
    tags: test_framework
```

## testing/integration/bt_crypto/testcase.yaml
```yaml
tests:
  integration.bt_crypto:
    platform_allow: native_posix_64 native_posix
    tags: bluetooth crypto
    integration_platforms: 
      - native_posix_64
      - native_posix
```

## testing/integration/rpa_psa_integration/testcase.yaml
```yaml
tests:
  # section.subsection
  sample.testing.rpa:
    # build_only: true
    platform_allow:
      - native_posix
      - native_sim
      - qemu_cortex_m3
    integration_platforms:
      - native_sim
      - qemu_cortex_m3
    tags: test_framework
```

## testing/unit/bt_le_cs_security_enable/testcase.yaml
```yaml
common:
  tags:
    - bluetooth
    - host
tests:
  bluetooth.host.cs.bt_le_cs_security_enable:
    type: unit
```

## testing/unit/channel_sounding/testcase.yaml
```yaml
common:
  tags:
    - bluetooth
    - host
tests:
  bluetooth.host.cs.channel_sounding:
    type: unit
```

## testing/unit/channel_sounding_behavior/testcase.yaml
```yaml
common:
  tags:
    - bluetooth
    - host
tests:
  bluetooth.host.cs.channel_sounding_behavior:
    type: unit
```

## testing/unit/deprecated_bt_encrypt_decrypt/unit_testing_unit_testing/tests/bluetooth/host/crypto/bt_encrypt_be/bluetooth.host.bt_encrypt_be.default/Kconfig/boards/Kconfig.sysbuild
```kconfig
# Load Sysbuild board Kconfig descriptions.
osource "/home/aleksandar/2023_Analysis_zephyr/zephyr/subsys/testsuite/boards/unit_testing/unit_testing/Kconfig.sysbuild"
```

## testing/unit/deprecated_bt_encrypt_decrypt/unit_testing_unit_testing/tests/bluetooth/host/crypto/bt_encrypt_decrypt/bluetooth.host.bt_encrypt_decrypt.default/Kconfig/boards/Kconfig.defconfig
```kconfig
# Load Zephyr board defconfig descriptions.
osource "/home/aleksandar/2023_Analysis_zephyr/zephyr/subsys/testsuite/boards/unit_testing/unit_testing/Kconfig.defconfig"
```

## testing/unit/deprecated_bt_encrypt_decrypt/unit_testing_unit_testing/tests/bluetooth/host/crypto/bt_encrypt_le/bluetooth.host.bt_encrypt_le.default/Kconfig/Kconfig.shield
```kconfig
osource "/home/aleksandar/2023_Analysis_zephyr/zephyr/subsys/testsuite/boards/shields/*/Kconfig.shield"
```

## testing/unit/deprecated_bt_encrypt_decrypt/unit_testing_unit_testing/tests/bluetooth/host/crypto/bt_rand/bluetooth.host.bt_rand.host_crypto_prng_disabled/Kconfig/arch/Kconfig
```kconfig
# Load Zephyr Arch Kconfig descriptions.
osource "/home/aleksandar/2023_Analysis_zephyr/zephyr/arch/x86/Kconfig"
osource "/home/aleksandar/2023_Analysis_zephyr/zephyr/arch/xtensa/Kconfig"
osource "/home/aleksandar/2023_Analysis_zephyr/zephyr/arch/sparc/Kconfig"
osource "/home/aleksandar/2023_Analysis_zephyr/zephyr/arch/riscv/Kconfig"
osource "/home/aleksandar/2023_Analysis_zephyr/zephyr/arch/posix/Kconfig"
osource "/home/aleksandar/2023_Analysis_zephyr/zephyr/arch/nios2/Kconfig"
osource "/home/aleksandar/2023_Analysis_zephyr/zephyr/arch/mips/Kconfig"
osource "/home/aleksandar/2023_Analysis_zephyr/zephyr/arch/arm64/Kconfig"
osource "/home/aleksandar/2023_Analysis_zephyr/zephyr/arch/arm/Kconfig"
osource "/home/aleksandar/2023_Analysis_zephyr/zephyr/arch/arc/Kconfig"
osource "/home/aleksandar/2023_Analysis_zephyr/zephyr/subsys/testsuite/arch/unit_testing/Kconfig"
```

## testing/unit/deprecated_bt_encrypt_decrypt/unit_testing_unit_testing/tests/bluetooth/host/crypto/bt_rand/bluetooth.host.bt_rand.host_crypto_prng_disabled/Kconfig/boards/Kconfig.unit_testing
```kconfig
# Load board Kconfig descriptions.
osource "/home/aleksandar/2023_Analysis_zephyr/zephyr/subsys/testsuite/boards/unit_testing/unit_testing/Kconfig.unit_testing"
```

## unit_testing/test_coverage/math_extras/unit_run_math_extras/unit_testing/tests/unit/math_extras/utilities.math/Kconfig/Kconfig.soc.arch
```kconfig
osource "/home/aleksandar/2023_Analysis_zephyr/zephyr/subsys/testsuite/soc/$(ARCH)/Kconfig"
osource "/home/aleksandar/2023_Analysis_zephyr/zephyr/subsys/testsuite/soc/$(ARCH)/*/Kconfig"
```

## unit_testing/test_coverage/math_extras/unit_run_math_extras/unit_testing/tests/unit/math_extras/utilities.math/Kconfig/Kconfig.soc.defconfig
```kconfig
osource "/home/aleksandar/2023_Analysis_zephyr/zephyr/subsys/testsuite/soc/$(ARCH)/*/Kconfig.defconfig"
```
